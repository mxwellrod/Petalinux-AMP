## OCM_demo/project-spec/configs/rootfsconfigs/Kconfig.user
```kconfig
menu "user packages " 
config freertos-ocm  
	 bool "freertos-ocm"
	 help
	
config gpio-demo  
	 bool "gpio-demo"
	 help
	
config linux-ocm  
	 bool "linux-ocm"
	 help
	
config peekpoke  
	 bool "peekpoke"
	 help
	
config read-ocm  
	 bool "read-ocm"
	 help
	
endmenu
```

## sweb_demo/project-spec/configs/rootfsconfigs/Kconfig.user
```kconfig
menu "user packages " 
config gpio-demo  
	 bool "gpio-demo"
	 help
	
config peekpoke  
	 bool "peekpoke"
	 help
	
config web-busybox  
	 bool "web-busybox"
	 help
	
endmenu
```

## webLEMP/project-spec/configs/rootfsconfigs/Kconfig.user
```kconfig
menu "user packages " 
config gpio-demo  
	 bool "gpio-demo"
	 help
	
config peekpoke  
	 bool "peekpoke"
	 help
	
config webserver  
	 bool "webserver"
	 help
	
endmenu
```
